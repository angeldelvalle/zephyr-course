## app/boards/custom_nucleo/Kconfig.defconfig
```kconfig
# STM32F767ZI Nucleo board configuration

# Copyright (c) 2019 Roland Ma
# SPDX-License-Identifier: Apache-2.0

if BOARD_CUSTOM_NUCLEO

configdefault NET_L2_ETHERNET
	default y

endif # BOARD_CUSTOM_NUCLEO
```

## app/boards/custom_nucleo/board.yml
```yaml
board:
  name: custom_nucleo
  full_name: Custom Nucleo
  vendor: Adelvalle
  socs:
    - name: stm32f767xx
```

## app/boards/my_nucleo/Kconfig.my_nucleo
```kconfig
#Copyright (c) 2026 Angel del Valle
#SPDX-License-Identifier: Apache-2.0

config BOARD_MY_NUCLEO
    select SOC_STM32F767XX
```

## app/boards/my_nucleo/board.yml
```yaml
board:
  name: my_nucleo
  full_name: My Nucleo
  vendor: adelvalle
  socs:
    - name: stm32f767xx
```
